## conf/distro/include/qcom-distro-dm-verity.inc
```bitbake
IMAGE_CLASSES += "dm-verity-img"
DM_VERITY_IMAGE_DATA_BLOCK_SIZE = "4096"
DM_VERITY_IMAGE_HASH_BLOCK_SIZE = "4096"
DM_VERITY_IMAGE = "qcom-multimedia-image"
DM_VERITY_IMAGE_TYPE = "ext4"
DM_VERITY_SEPARATE_HASH = "0"

IMAGE_QCOMFLASH_FS_TYPE = "ext4.verity"
```

## conf/distro/qcom-distro-dm-verity.conf
```bitbake
require conf/distro/include/qcom-base.inc
require conf/distro/include/qcom-distro-dm-verity.inc
```
