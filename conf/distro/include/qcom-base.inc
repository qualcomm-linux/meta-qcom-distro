## conf/distro/include/qcom-base.inc
```bitbake
DISTRO_NAME = "Qualcomm Linux Reference Distro"

DISTRO_VERSION = "2.0"

# SDK variables.
SDK_VERSION = "${DISTRO_VERSION}"
SDK_NAME = "${DISTRO}-${SDKMACHINE}-${IMAGE_BASENAME}-${TUNE_PKGARCH}-${MACHINE}"
SDK_VENDOR = "-qcomsdk"

TARGET_VENDOR = "-qcom"

# Ensure 'qcom-distro' appear at most once in DISTROOVERRIDES
DISTROOVERRIDES =. "${@ 'qcom-distro:' if d.getVar('DISTRO') != 'qcom-distro' else ''}"

DISTRO_FEATURES:append = " \
    efi \
    glvnd \
    minidebuginfo \
    opencl \
    overlayfs \
    pam \
    pni-names \
    security \
    tpm2 \
    virtualization \
    wifi \
    x11 \
"

# Use systemd init manager for system initialization.
INIT_MANAGER = "systemd"

# Activate systemd watchdog
WATCHDOG_RUNTIME_SEC:pn-systemd = "30"

# Use rsyslog as default syslog utility
VIRTUAL-RUNTIME_base-utils-syslog = "rsyslog"

# Prepare a flat image directory structure suitable to flash with QDL
IMAGE_CLASSES += "image_types_qcom"
IMAGE_FSTYPES += "qcomflash"

# Set a default package class to avoid surprises
PACKAGE_CLASSES = "package_rpm"

# Avoid to duplicate the rootfs tarball by generating both tar.gz/tar.xz
IMAGE_FSTYPES:remove = "tar.gz"

# Extended SPDX / SBOM options
## Include kernel config by default in SBOM
SPDX_INCLUDE_KERNEL_CONFIG ?= "1"

# Pull in the initrd image by default
INITRAMFS_IMAGE = "initramfs-rootfs-image"

INHERIT += "buildhistory"
INHERIT += "image-buildinfo"
INHERIT += "recipe_sanity"

BUILDHISTORY_COMMIT = "1"

# Disable weston idle timeout
PACKAGECONFIG:append:pn-weston-init = " no-idle-timeout"

PACKAGECONFIG:append:pn-qemu = " pixman virtfs vnc-jpeg vnc-sasl"

# Prefer TensorFlow Lite 2.16 due to availability of DSP‑certified AIHUB models
PREFERRED_VERSION_tensorflow-lite ??= "2.16.1"
PREFERRED_VERSION_flatbuffers-tflite ??= "23.5.26"
```

## conf/distro/include/qcom-distro-gunyah.inc
```bitbake
DISTRO_FEATURES:append = " \
    gunyah \
"

DISTRO_NAME:append = " (Gunyah-enabled)"

# Gunyah and KVM are mutually exclusive
CONFLICT_DISTRO_FEATURES = "kvm"
```

## conf/distro/include/qcom-distro-kvm.inc
```bitbake
DISTRO_FEATURES:append = " \
    kvm \
"

DISTRO_NAME:append = " (KVM-enabled)"

# Gunyah and KVM are mutually exclusive
CONFLICT_DISTRO_FEATURES = "gunyah"
```

## conf/distro/include/qcom-distro-sota.inc
```bitbake
require conf/distro/sota.conf.inc

INITRAMFS_IMAGE = "initramfs-ostree-image"

DISTRO_NAME:append = " (OTA-enabled)"

# ptest is not generally useful with ostree-based images (ro /usr)
DISTRO_FEATURES_BACKFILL_CONSIDERED += "ptest"

# Generate an OSTree repository tarball during image build
BUILD_OSTREE_REPO_TARBALL = "1"
```

## conf/distro/qcom-distro-catchall.conf
```bitbake
require conf/distro/include/qcom-base.inc

#SELinux
require conf/distro/include/qcom-distro-selinux.inc

#SOTA
require conf/distro/include/qcom-distro-sota.inc
```

## conf/distro/qcom-distro-container-orchestration.conf
```bitbake
require conf/distro/qcom-distro.conf

DISTRO_FEATURES:append = " \
    virtualization \
"

DISTRO_NAME:append = " (container-orchestration-enabled)"
```

## conf/distro/qcom-distro-extended-debug.conf
```bitbake
require conf/distro/qcom-distro.conf

DISTRO_FEATURES:append = " extended-debug"

DISTRO_FEATURES_OVERRIDES += "extended-debug"

DISTRO_NAME:append = " (extended-debug-options-enabled)"
```

## conf/distro/qcom-distro-gunyah.conf
```bitbake
require conf/distro/include/qcom-base.inc
require conf/distro/include/qcom-distro-gunyah.inc
```

## conf/distro/qcom-distro-kvm.conf
```bitbake
require conf/distro/include/qcom-base.inc
require conf/distro/include/qcom-distro-kvm.inc
```

## conf/distro/qcom-distro-optimized-perf.conf
```bitbake
require conf/distro/qcom-distro.conf

DISTRO_FEATURES:append = " optimized-perf"

DISTRO_FEATURES_OVERRIDES += "optimized-perf"

DISTRO_NAME:append = " (performance-optimizations-enabled)"
```

## conf/distro/qcom-distro-selinux.conf
```bitbake
require conf/distro/include/qcom-base.inc
require conf/distro/include/qcom-distro-selinux.inc
```

## conf/distro/qcom-distro-sota.conf
```bitbake
require conf/distro/include/qcom-base.inc
require conf/distro/include/qcom-distro-sota.inc
```

## conf/distro/qcom-distro.conf
```bitbake
require conf/distro/include/qcom-base.inc

# Allow AAC codec only for PipeWire
LICENSE_FLAGS_ACCEPTED:pn-fdk-aac = "commercial"
PACKAGECONFIG:append:pn-pipewire = " bluez-aac"
```

## conf/distro/qcom-wayland.conf
```bitbake
require conf/distro/include/qcom-base.inc

DISTRO_FEATURES:append = " wayland vulkan opengl"

DISTRO_FEATURES:remove = "x11"
```

## conf/distro/qcom.conf
```bitbake
require conf/distro/include/qcom-base.inc

DISTRO_NAME = "QCOM Reference Distro with Wayland"

DISTRO_FEATURES:append = " wayland x11 opengl vulkan"

DISTROOVERRIDES = "qcom-wayland"
```

## conf/layer.conf
```bitbake
# We have a conf and classes directory, add to BBPATH
BBPATH .= ":${LAYERDIR}"

# We have a packages directory, add to BBFILES
BBFILES += "${LAYERDIR}/recipes-*/*/*.bb \
            ${LAYERDIR}/recipes-*/*/*.bbappend"

BBFILE_COLLECTIONS        += "qcom-distro"
BBFILE_PATTERN_qcom-distro := "^${LAYERDIR}/"
BBFILE_PRIORITY_qcom-distro = "10"

BBFILES_DYNAMIC += " \
    multimedia-layer:${LAYERDIR}/dynamic-layers/meta-multimedia/*/*/*.bb \
    multimedia-layer:${LAYERDIR}/dynamic-layers/meta-multimedia/*/*/*.bbappend \
    networking-layer:${LAYERDIR}/dynamic-layers/meta-networking/*/*/*.bb \
    networking-layer:${LAYERDIR}/dynamic-layers/meta-networking/*/*/*.bbappend \
    xfce-layer:${LAYERDIR}/dynamic-layers/meta-xfce/*/*/*.bb \
    xfce-layer:${LAYERDIR}/dynamic-layers/meta-xfce/*/*/*.bbappend \
    "

LAYERDEPENDS_qcom-distro = "core qcom"
LAYERSERIES_COMPAT_qcom-distro = "styhead walnascar"
```
